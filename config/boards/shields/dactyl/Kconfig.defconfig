## config/boards/shields/dactyl/Kconfig.defconfig
```kconfig
if SHIELD_DACTYL_RIGHT

# Name must be less than 16 characters long!
config ZMK_KEYBOARD_NAME
    default "dactyl"

config ZMK_SPLIT_ROLE_CENTRAL
    default y

endif

if SHIELD_DACTYL_LEFT || SHIELD_DACTYL_RIGHT

config ZMK_SPLIT
    default y

endif
```

## config/boards/shields/dactyl/Kconfig.shield
```kconfig
# No whitespace after the comma or in your part name!
config SHIELD_DACTYL_LEFT
    def_bool $(shields_list_contains,sweep_left)

# No whitespace after the comma or in your part name!
config SHIELD_DACTYL_RIGHT
    def_bool $(shields_list_contains,sweep_right)
```
